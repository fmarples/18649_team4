## tests/blinker_core/testcase.yaml
```yaml
tests:
  lab2.blinker_core:
    platform_allow: qemu_cortex_m3
    tags: [blinkers]
```

## tests/integration/testcase.yaml
```yaml
tests:
  lab2.integration:
    platform_allow: qemu_cortex_m3
    tags: [motors, blinkers, steering]
```
