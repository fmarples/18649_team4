## CMakeLists.txt
```
cmake_minimum_required(VERSION 3.28.0)
find_package(Zephyr REQUIRED HINTS $ENV{ZEPHYR_BASE})
project(lab2_integration_tests)
target_include_directories(app PRIVATE ../../stm32_zephyr/src ../../bringup/motor_test/src)
target_sources(app PRIVATE
    src/actuators.c src/drive.c src/velocity.c src/bench.c src/throttle.c src/currents.c
    ../../stm32_zephyr/src/current_cache.c
    ../blinker_core/src/main.c ../blinker_core/src/self_test.c ../blinker_core/src/servo.c
    ../../stm32_zephyr/src/actuator_policy.c
    ../../stm32_zephyr/src/blinker_core.c ../../stm32_zephyr/src/self_test.c
    ../../stm32_zephyr/src/servo_core.c ../../stm32_zephyr/src/drive_control.c
    ../../stm32_zephyr/src/throttle_mapping.c
    ../../bringup/motor_test/src/velocity_control.c ../../bringup/motor_test/src/bench_control.c)

# Run the real ADC backend against a hardware double at all supported bench
# populations. Keep the fake ADC header local to these objects, never firmware.
foreach(mask 0 5 7)
  add_library(adc_contract_${mask} OBJECT ../test_current_backend.c
      ../../stm32_zephyr/src/current_backend.c)
  target_link_libraries(adc_contract_${mask} PRIVATE zephyr_interface)
  target_include_directories(adc_contract_${mask} BEFORE PRIVATE
      ../current_adc_fake ../../stm32_zephyr/src)
  target_compile_definitions(adc_contract_${mask} PRIVATE
      CONFIG_LAB_CURRENT_CHANNEL_MASK=${mask}
      CONFIG_LAB_CURRENT_LEFT_ZERO_MV=2500 CONFIG_LAB_CURRENT_RIGHT_ZERO_MV=2500
      CONFIG_LAB_CURRENT_SERVO_ZERO_MV=2500
      CONFIG_LAB_CURRENT_LEFT_SENSITIVITY=185 CONFIG_LAB_CURRENT_RIGHT_SENSITIVITY=185
      CONFIG_LAB_CURRENT_SERVO_SENSITIVITY=185
      main=adc_contract_${mask}_entry test_adc=test_adc_${mask}
      device_is_ready=fake_ready_${mask} adc_read=fake_read_${mask}
      adc_channel_setup=fake_setup_${mask} current_backend_read=backend_read_${mask})
  target_sources(app PRIVATE $<TARGET_OBJECTS:adc_contract_${mask}>)
endforeach()
target_sources(app PRIVATE src/adc_backend.c)
```

## prj.conf
```kconfig
CONFIG_ZTEST=y
CONFIG_MAIN_STACK_SIZE=4096
CONFIG_ASSERT=y
# Native C motor tests include software floating point and formatted output.
CONFIG_ZTEST_STACK_SIZE=8192
CONFIG_STACK_SENTINEL=y
```

## src/actuators.c
```c
#include <zephyr/ztest.h>
#include "actuator_policy.h"
#include "self_test.h"
#include "blinker_core.h"
#include "servo_core.h"
#include "schedule.h"

static struct servo_control calibrated(void)
{
    return (struct servo_control){.left = 1200, .center = 1600, .right = 2000, .marks = 7};
}

ZTEST(actuators, test_startup_and_normal_controls)
{
    struct drive_control motor;
    struct blinker lamps;
    struct servo_control servo = calibrated();
    zassert_true(servo_auto(&servo));
    drive_init(&motor);
    blinker_reset(&lamps);
    struct actuator_policy p = actuator_policy_evaluate(WAITING, false, false, false, 32767, 300000);
    zassert_equal(p.reported_state, WAITING);
    zassert_equal(drive_step(&motor, p.drive, 0, 0, 0).mode, DRIVE_BRAKE);
    struct blink_output out = blinker_step(&lamps, 0, p.linked, p.hazards, 0, 0);
    zassert_true(out.left && out.right);
    zassert_equal(servo.mode, SERVO_WAIT_CENTER);
    p = actuator_policy_evaluate(LINK_OK, false, false, false, 32767, 300000);
    zassert_equal(drive_step(&motor, p.drive, 0, 0, 1).mode, DRIVE_FORWARD);
    out = blinker_step(&lamps, 1, p.linked, p.hazards, 0, 0);
    zassert_false(out.left || out.right);
    servo_tick(&servo, 1, p.linked, p.inhibit_servo, 0);
    zassert_equal(servo.mode, SERVO_LIVE); /* Healthy link and centered wheel enable steering. */
}

ZTEST(actuators, test_self_test_brakes_during_kick_and_disables_steering)
{
    struct drive_control motor;
    struct self_test test;
    struct blinker lamps;
    struct servo_control servo = calibrated();
    drive_init(&motor); self_test_reset(&test); blinker_reset(&lamps);
    struct actuator_policy p = actuator_policy_evaluate(LINK_OK, false, false, false, 32767, 300000);
    zassert_equal(drive_step(&motor, p.drive, 0, 0, 0).mode, DRIVE_FORWARD);
    zassert_true(servo_arm(&servo, 0, false));
    zassert_true(servo_live(&servo, true, false, 0));
    self_test_input(&test, 10, SELF_TEST_BUTTON);
    p = actuator_policy_evaluate(LINK_OK, false, false, test.active, 32767, 300000);
    zassert_equal(p.reported_state, SELF_TEST);
    zassert_equal(drive_step(&motor, p.drive, -2, 2, 10).mode, DRIVE_BRAKE);
    servo_tick(&servo, 10, p.linked, p.inhibit_servo, 0);
    zassert_equal(servo.mode, SERVO_WAIT_CENTER);
    zassert_equal(servo.pulse, 0);
    struct blink_output out = blinker_step(&lamps, 10, p.linked, p.hazards, 0, 0);
    zassert_true(out.left && out.right);
    self_test_input(&test, 40, 0);
    self_test_input(&test, 100, SELF_TEST_BUTTON);
    p = actuator_policy_evaluate(LINK_OK, false, false, test.active, 32767, 300000);
    zassert_equal(p.reported_state, LINK_OK);
    zassert_equal(drive_step(&motor, p.drive, -5, 5, 100).mode, DRIVE_FORWARD);
    servo_tick(&servo, 100, p.linked, p.inhibit_servo, 32767);
    zassert_equal(servo.mode, SERVO_WAIT_CENTER); /* Clearing a fault alone must not enable turned steering. */
    servo_tick(&servo, 101, p.linked, p.inhibit_servo, 0);
    zassert_equal(servo.mode, SERVO_LIVE);
}

ZTEST(actuators, test_real_faults_override_cleared_self_test)
{
    struct self_test test;
    self_test_reset(&test);
    self_test_input(&test, 0, SELF_TEST_BUTTON);
    self_test_input(&test, 30, 0);
    self_test_input(&test, 100, SELF_TEST_BUTTON);
    zassert_false(test.active);
    struct actuator_policy p = actuator_policy_evaluate(TIMEOUT, false, false, test.active, 32767, 300000);
    struct drive_control motor;
    drive_init(&motor);
    zassert_equal(p.reported_state, TIMEOUT);
    zassert_true(p.hazards);
    zassert_equal(drive_step(&motor, p.drive, 0, 0, 100).mode, DRIVE_BRAKE);
    struct servo_control servo = calibrated();
    servo_arm(&servo, 0, false); servo_live(&servo, true, false, 0);
    servo_tick(&servo, 100, p.linked, p.inhibit_servo, 0);
    zassert_equal(servo.mode, SERVO_WAIT_CENTER);
    zassert_equal(servo.pulse, 0);
    p = actuator_policy_evaluate(LINK_OK, true, false, false, 32767, 300000);
    zassert_equal(p.reported_state, MOTOR_FAULT);
    zassert_true(p.hazards && p.inhibit_servo);
    p = actuator_policy_evaluate(LINK_OK, false, true, false, 32767, 300000);
    zassert_equal(p.reported_state, ACTUATOR_FAULT);
    zassert_true(p.hazards && p.inhibit_servo);
    zassert_equal(drive_step(&motor, p.drive, 0, 0, 101).mode, DRIVE_BRAKE);
}

ZTEST(actuators, test_b1_remains_latched_with_self_test_recovery)
{
    struct drive_control motor;
    drive_init(&motor);
    struct actuator_policy p = actuator_policy_evaluate(LINK_OK, false, false, false, 32767, 300000);
    drive_step(&motor, p.drive, 0, 0, 0);
    p.drive.local_stop = true;
    zassert_equal(drive_step(&motor, p.drive, 0, 0, 10).mode, DRIVE_COAST);
    zassert_equal(motor.fault, DRIVE_B1_STOP);
    p = actuator_policy_evaluate(LINK_OK, true, false, false, 32767, 300000);
    zassert_equal(p.reported_state, MOTOR_FAULT);
    zassert_equal(drive_step(&motor, p.drive, 0, 0, 20).mode, DRIVE_COAST);
}

ZTEST(actuators, test_paddle_steering_and_brake_remain_independent)
{
    struct blinker lamps;
    struct drive_control motor;
    struct servo_control servo = calibrated();
    blinker_reset(&lamps); drive_init(&motor);
    blinker_step(&lamps, 0, true, false, 0, 0);
    struct actuator_policy p = actuator_policy_evaluate(LINK_OK, false, false, false, -32768, 300000);
    struct blink_output out = blinker_step(&lamps, 20, p.linked, p.hazards, BLINK_LEFT_BUTTON, 0);
    zassert_true(out.left && !out.right);
    zassert_equal(drive_step(&motor, p.drive, 0, 0, 20).mode, DRIVE_BRAKE);
    zassert_false(p.inhibit_servo); /* Pedal brake does not disable steering. */
    zassert_equal(servo_map(&servo, -32768), 1200);
    zassert_equal(servo_map(&servo, 0), 1600);
    zassert_equal(servo_map(&servo, 32767), 2000);
    blinker_step(&lamps, 30, true, false, 0, -9000);
    out = blinker_step(&lamps, 40, true, false, 0, -5000);
    zassert_false(out.left || out.right);
}
ZTEST_SUITE(actuators, NULL, NULL, NULL, NULL, NULL);

ZTEST(actuators, test_three_missed_commands_stop_at_boundary)
{
    struct drive_control motor;
    drive_init(&motor);
    uint32_t last_received = 40; /* Commands at 0, 20 and 40 ms, then silence. */
    zassert_false(lab_link_expired(99, last_received));
    struct actuator_policy p = actuator_policy_evaluate(LINK_OK, false, false, false, 32767, 300000);
    zassert_equal(drive_step(&motor, p.drive, 0, 0, 99).mode, DRIVE_FORWARD);
    zassert_true(lab_link_expired(100, last_received));
    p = actuator_policy_evaluate(TIMEOUT, false, false, false, 32767, 300000);
    zassert_equal(drive_step(&motor, p.drive, 0, 0, 100).mode, DRIVE_BRAKE);
    zassert_true(p.hazards);
    zassert_false(lab_link_expired(100, 80)); /* A fresh command resets the deadline. */
}
ZTEST(actuators, test_command_age_wrap)
{
    uint32_t last_received = UINT32_MAX - 29;
    zassert_false(lab_link_expired(29, last_received));
    zassert_true(lab_link_expired(30, last_received));
    zassert_true(lab_link_expired(31, last_received));
}
```

## src/adc_backend.c
```c
#include <zephyr/ztest.h>
int adc_contract_0_entry(void);
int adc_contract_5_entry(void);
int adc_contract_7_entry(void);
ZTEST(adc_backend, test_disabled) { zassert_equal(adc_contract_0_entry(), 0); }
ZTEST(adc_backend, test_left_and_servo) { zassert_equal(adc_contract_5_entry(), 0); }
ZTEST(adc_backend, test_all_and_faults) { zassert_equal(adc_contract_7_entry(), 0); }
ZTEST_SUITE(adc_backend, NULL, NULL, NULL, NULL, NULL);
```

## src/bench.c
```c
#include <zephyr/ztest.h>
#define main bench_contract_entry
#include "../../test_motor_bench.c"
#undef main
ZTEST(motor_contracts, test_bench_compatibility) { zassert_equal(bench_contract_entry(), 0); }
```

## src/currents.c
```c
#include <zephyr/ztest.h>
#include "current_cache.h"

ZTEST(currents, test_boot_never_publishes_fake_zero)
{
    struct current_sample cache = {0};
    struct current_sample value = current_cache_snapshot(&cache, 0, 100);
    zassert_equal(value.valid_mask, 0);
    for (unsigned i = 0; i < 3; i++) zassert_equal(value.ma[i], CURRENT_UNAVAILABLE);
}
ZTEST(currents, test_channel_validity_and_signed_zero_measurements)
{
    struct current_sample cache;
    int32_t ma[3] = {0, -42, 100};
    current_cache_publish(&cache, ma, 0xFB, 20);
    struct current_sample value = current_cache_snapshot(&cache, 30, 100);
    zassert_equal(value.valid_mask, 3);
    zassert_equal(value.ma[0], 0); zassert_equal(value.ma[1], -42);
    zassert_equal(value.ma[2], CURRENT_UNAVAILABLE);
}
ZTEST(currents, test_age_limit_wrap_and_recovery)
{
    struct current_sample cache;
    int32_t ma[3] = {10, 20, 30};
    current_cache_publish(&cache, ma, 7, UINT32_MAX - 49);
    zassert_equal(current_cache_snapshot(&cache, 49, 100).valid_mask, 7);
    zassert_equal(current_cache_snapshot(&cache, 50, 100).valid_mask, 0);
    current_cache_publish(&cache, ma, 7, 51);
    zassert_equal(current_cache_snapshot(&cache, 51, 100).valid_mask, 7);
}
ZTEST(currents, test_invalid_sentinel_and_failed_replacement)
{
    struct current_sample cache;
    int32_t ma[3] = {CURRENT_UNAVAILABLE, 200, 300};
    current_cache_publish(&cache, ma, 7, 0);
    zassert_equal(cache.valid_mask, 6);
    current_cache_publish(&cache, ma, 0, 20);
    struct current_sample value = current_cache_snapshot(&cache, 20, 100);
    zassert_equal(value.valid_mask, 0);
    for (unsigned i = 0; i < 3; i++) zassert_equal(value.ma[i], CURRENT_UNAVAILABLE);
}
ZTEST_SUITE(currents, NULL, NULL, NULL, NULL, NULL);
```

## src/drive.c
```c
#include <zephyr/ztest.h>
/* Run main's existing production-controller contract unchanged on ARM/QEMU. */
#define main drive_contract_entry
#include "../../test_drive_control.c"
#undef main
ZTEST(motor_contracts, test_drive) { zassert_equal(drive_contract_entry(), 0); }
ZTEST_SUITE(motor_contracts, NULL, NULL, NULL, NULL, NULL);
```

## src/throttle.c
```c
#include <zephyr/ztest.h>
#define main throttle_contract_entry
#include "../../test_throttle_mapping.c"
#undef main
ZTEST(motor_contracts, test_throttle) { zassert_equal(throttle_contract_entry(), 0); }
```

## src/velocity.c
```c
#include <zephyr/ztest.h>
#define main velocity_contract_entry
#include "../../test_velocity_control.c"
#undef main
ZTEST(motor_contracts, test_velocity) { zassert_equal(velocity_contract_entry(), 0); }
```
